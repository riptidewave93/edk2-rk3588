// SPDX-License-Identifier: (GPL-2.0+ OR MIT)

#include "rk3588-rock-5b-plus.dts"

&{/leds} {
    led_rgb_b {
        function = LED_FUNCTION_SD;
        linux,default-trigger = "mmc1";
    };
};

&sfc {
	pinctrl-names = "default";
	pinctrl-0 = <&fspim2_pins>;
	status = "okay";

	spi_flash: flash@0 {
		compatible = "jedec,spi-nor";
		reg = <0x0>;
		spi-max-frequency = <50000000>;
		spi-rx-bus-width = <4>;
		spi-tx-bus-width = <1>;
	};
};
